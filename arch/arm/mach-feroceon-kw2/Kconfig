## arch/arm/mach-feroceon-kw2/Kconfig
```kconfig
if ARCH_FEROCEON_KW2

choice
	prompt "Feroceon-KW2 SoC type"
	default MV88F6500

config  MV88F6500
	bool "88F6510/88F6530/88F6550/88F6560/ SoC"
	---help---
	Choosing this option will generate a linux kernel for the 88F6510/88F6530/88F6550/88F6560/ SoC

endchoice

choice
	prompt "Feroceon-KW2 board type"

config MACH_GFLT200
	bool "GFLT200 board"
	depends on MV88F6500

config MACH_GFLT110
	bool "GFLT110 board"
	depends on MV88F6500

endchoice

endif
```

## arch/arm/plat-feroceon/mv_drivers_lsp/mv_cph/Kconfig
```kconfig
menu "SoC CPH support"
depends on MV_INCLUDE_CPH

config  MV_CPH
        bool "Support for Marvell CPU Packet Handler Driver"
        default y
        ---help---

comment "CPH Driver Options"
depends on MV_CPH

config  MV_CPH_IGMP_HANDLE
        bool "Enable MV_CPH IGMP handling"
        default y
        ---help---

config  MV_CPH_MLD_HANDLE
        bool "Enable MV_CPH MLD handling"
        default y
        ---help---

config  MV_CPH_BC_HANDLE
        bool "Enable MV_CPH broadcast handling"
        default y
        ---help---
        
config  MV_CPH_UDP_SAMPLE_HANDLE
        bool "Enable MV_CPH sample UDP handling"
        default n
        ---help---

config  MV_CPH_FLOW_MAP_HANDLE
        bool "Enable MV_CPH flow mapping handling"
        default y
        ---help---        

endmenu
```

## arch/arm/plat-feroceon/mv_drivers_lsp/mv_cust/Kconfig
```kconfig
menu "SoC CUST support"
depends on MV_INCLUDE_CUST

config  MV_CUST
	bool "Support for Marvell Customer Driver"
      	default y
	---help---

config  MV_CUST_IGMP_HANDLE
        bool "Enable MV_CUST IGMP handling"
        default y
        ---help---

config  MV_CUST_UDP_SAMPLE_HANDLE
        bool "Enable MV_CUST sample UDP handling"
        default n
        ---help---

config  MV_CUST_FLOW_MAP_HANDLE
        bool "Enable MV_CUST flow mapping handling"
        default y
        ---help---        

endmenu
```

## arch/arm/plat-feroceon/mv_drivers_lsp/mv_mac_learn/Kconfig
```kconfig
menu "SoC MAC learning support"
depends on MV_INCLUDE_TPM

config  MV_MAC_LEARN
	bool "Support for MAC learning through PnC"
      	default n
	---help---

endmenu
```

## arch/arm/plat-feroceon/mv_drivers_lsp/mv_phone/Kconfig
```kconfig
menu "Telephony options"
	depends on MV_INCLUDE_TDM

config  MV_PHONE
	bool "Support for Marvell telephony(VoIP)"
	depends on MV_INCLUDE_TDM && PHONE
	default y
	---help---
	  Choosing this option enables the Marvell telephony underlying 
	  support for various VoIP applications. 
	  Note, kernel Telephony subsystem must be chosen too.

choice 
	prompt "TDM Unit"
	depends on MV_PHONE
	default MV_TDM_SUPPORT

config MV_TDM_SUPPORT
	bool "Support legacy TDM(2 channels)"

config MV_COMM_UNIT_SUPPORT
	depends on ARCH_FEROCEON_KW2
	bool "Support CommUnit(up to 32 channels)"

endchoice

choice 
	prompt "SLIC Vendor"
	depends on MV_PHONE
	default ZARLINK_SLIC_SUPPORT

config SILABS_SLIC_SUPPORT
	bool "Support Silicon Labs devices"

config ZARLINK_SLIC_SUPPORT
	bool "Support Zarlink/Legirity devices"

endchoice

choice 
	prompt "SLIC Device"
	depends on MV_PHONE && SILABS_SLIC_SUPPORT

config SILAB_SLIC_SI3226x
	bool "Support Silicon Labs 3226x device"
	
config SILAB_SLIC_SI3217x
	bool "Support Silicon Labs 3217x device"

endchoice

choice 
	prompt "SLIC Device"
	depends on MV_PHONE && ZARLINK_SLIC_SUPPORT
	default ZARLINK_SLIC_VE880

config ZARLINK_SLIC_VE880
	bool "Support Zarlink VE880 SLIC family"

config ZARLINK_SLIC_VE890
	bool "Support Zarlink VE890 SLIC family"

config ZARLINK_SLIC_VE792
	bool "Support Zarlink VE792 SLIC family"

endchoice

choice 
	prompt "PCM Clock Frequency"
	depends on MV_PHONE
	default MV_TDM_PCM_CLK_8MHZ
	---help---
	This menu selects the PCM clock frequency generated by the TDM master.
	SLIC should be configured accordingly in order to maintain bus coherency.
 
config MV_TDM_PCM_CLK_8MHZ
	bool "Support 8MHz PCM clock"

config MV_TDM_PCM_CLK_4MHZ
	bool "Support 4MHz PCM clock"

config MV_TDM_PCM_CLK_2MHZ
	bool "Support 2MHz PCM clock"

endchoice

choice 
	prompt "TDM Clock Source"
	depends on MV_PHONE
	default MV_TDM_USE_INTERNAL_PCLK_SOURCE

config MV_TDM_USE_INTERNAL_PCLK_SOURCE
	bool "Support PCLK internally generated"

config MV_TDM_USE_EXTERNAL_PCLK_SOURCE
	bool "Support PCLK from external source"

config MV_TDM_USE_DCO
	bool "Support PCLK from DCO enabled PLL"

endchoice

choice 
	prompt "TDM voice processing"
	depends on MV_PHONE
	default MV_TDM_DUMMY

config MV_TDM_DUMMY
	bool "Support TDM voice processing in softIRQ"

config MV_PHONE_USE_IRQ_PROCESSING
	bool "Support TDM voice processing in IRQ"

config MV_PHONE_USE_FIQ_PROCESSING
	bool "Support TDM voice processing in FIQ"

endchoice

config MV_PHONE_USE_SLIC_LIBS
	bool "Use binary SLIC drivers"
	depends on MV_PHONE
	default y
	---help---
	Unselect this option only if you have source code of SLIC drivers.
	If unsure, say "y"

config MV_TDM_EXT_STATS
	bool "Enable legacy TDM extended statistics"
	depends on MV_TDM_SUPPORT
	default n
	---help---
	Choosing this option will export extended statistics to procfs.
	This is relevant only for the legacy TDM unit.

endmenu
```

## arch/arm/plat-feroceon/mv_drivers_lsp/mv_pon/Kconfig
```kconfig
menu "SoC PON support"
depends on MV_INCLUDE_PON

config MV_PON_TCONTS
        int "GPON maximum T-CONT's number"
        default 8 
        ---help---

config MV_EPON_LLID
        int "EPON maximum LLID number"
        default 1
        ---help---

config PON_Z1
	bool "Support for PON Z1 Driver"
      	default y
	---help---

config PON_Z2
	bool "Support for PON Z2 Driver"
      	default n
	---help---

config PON_FPGA
	bool "Support for PON Driver for FPGA"
      	default n
	---help---

config  MV_GPON
	bool "Support for Marvell GPON Driver"
	depends on MV_INCLUDE_PON
	default y
	---help---

config  MV_EPON
	bool "Support for Marvell EPON Driver"
	depends on MV_INCLUDE_PON
	default y
	---help---


comment "GPON Driver Options"
depends on MV_GPON

config  MV_GPON_HW_INTERRUPT
	bool "Support for GPON HW Interrupt"
	depends on MV_GPON
      	default y
	---help---

config  MV_GPON_DEBUG_PRINT
	bool "Support for GPON Debug printing"
	depends on MV_GPON
      	default y
	---help---

config  MV_GPON_STATIC_GEM_PORT
	bool "Support for GPON Static Gem Port"
	depends on MV_GPON
      	default y
	---help---

config  MV_GPON_PERFORMANCE_CHECK
	bool "Support for GPON Performance Validation"
	depends on MV_GPON
      	default n
	---help---

comment "EPON Driver Options"
depends on MV_EPON

config  MV_EPON_HW_INTERRUPT
	bool "Support for EPON HW Interrupt"
	depends on MV_EPON
      	default y
	---help---

config  MV_EPON_DBA_LOW_RATE_VALUE
        int "DBA report low rate value (Bytes)"
	depends on MV_EPON
        default 2000 
        ---help---
        
config  MV_EPON_DBA_LOW_RATE_THRESHOLD
        int "DBA report low rate threshold (msec)"
	depends on MV_EPON
        default 20 
        ---help---

config  MV_EPON_DBA_LOW_RATE_CONST_VALUE
        int "DBA report low rate const value (Bytes)"
	depends on MV_EPON
        default 256 
        ---help---

config  MV_EPON_DBA_HIGH_RATE_THRESHOLD
        int "DBA report high rate threshold (Bytes)"
	depends on MV_EPON
        default 8192 
        ---help---

config  MV_EPON_DBA_HIGH_RATE_VALUE
        int "DBA report high rate value (Bytes)"
	depends on MV_EPON
        default 2000 
        ---help---

endmenu
```

## arch/arm/plat-feroceon/mv_drivers_lsp/mv_tpm/Kconfig
```kconfig
menu "SoC TPM support"
depends on MV_INCLUDE_TPM

config  MV_TPM
	tristate "Support for Marvell TPM Driver"
      	default y
	---help---

comment "TPM Driver Options"
depends on MV_TPM

config  MV_TPM_Z1_VER
	bool "Support for TPM Z1 Version"
	depends on MV_TPM
      	default n
	---help---

config  MV_TPM_Z2_VER
	bool "Support for TPM Z2 Version"
	depends on MV_TPM
      	default y
	---help---

config  MV_TPM_FPGA_VER
	bool "Support for TPM FPGA Version"
	depends on MV_TPM
      	default n
	---help---

config  MV_TPM_INT_LOCK
	bool "Support for TPM Protection - Int Lock"
	depends on MV_TPM
      	default n
	---help---

config  MV_TPM_DEBUG_PRINT
	bool "Support for tpm Debug printing"
	depends on MV_TPM
      	default N
	---help---

config  MV_TPM_SFS_2_IOCTL
	bool "Support for debugging ioctl API via sysfs interface"
	depends on MV_TPM
	default N
	---help---
	
config  MV_TPM_SYSFS_HELP
	bool "Support for tpm sysfs help"
	depends on MV_TPM
      	default Y
	---help---

endmenu
```
